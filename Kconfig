## Kconfig
```kconfig
if BOARD_ACER_ASPIRE_E1-571

config BOARD_SPECIFIC_OPTIONS # dummy
	def_bool y
	select BOARD_ROMSIZE_KB_5120
	select CPU_INTEL_SOCKET_RPGA989
	select EC_ACPI
	select HAVE_ACPI_RESUME
	select HAVE_ACPI_TABLES
	select INTEL_EDID
	select INTEL_INT15
	select IVYBRIDGE_LVDS
	select MAINBOARD_HAS_NATIVE_VGA_INIT
	select MAINBOARD_HAS_NATIVE_VGA_INIT_TEXTMODECFG
	select NORTHBRIDGE_INTEL_IVYBRIDGE
	select SERIRQ_CONTINUOUS_MODE
	select SOUTHBRIDGE_INTEL_C216
	select SYSTEM_TYPE_LAPTOP
	select VGA

config HAVE_IFD_BIN
	bool
	default n

config HAVE_ME_BIN
	bool
	default n

config MAINBOARD_DIR
	string
	default acer/aspire_e1-571

config MAINBOARD_PART_NUMBER
	string
	default "Aspire E1-571"

config VGA_BIOS_FILE
	string
	default "pci8086,0166.rom"

config VGA_BIOS_ID
	string
	default "8086,0166"

config MAINBOARD_PCI_SUBSYSTEM_DEVICE_ID
	hex
	default 0x64b

config MAINBOARD_PCI_SUBSYSTEM_VENDOR_ID
	hex
	default 0x1025

config MMCONF_BASE_ADDRESS
	hex
	default 0xf0000000

config DRAM_RESET_GATE_GPIO
	int
	default 60

config MAX_CPUS
	int
	default 8

config USBDEBUG_HCD_INDEX # FIXME: check this
	int
	default 2
endif
```
